/dts-v1/;
/plugin/;
#include <dt-bindings/gpio/gpio.h>
#include <dt-bindings/input/input.h>
/ {
  compatible = "xunlong,orangepi-lite", "allwinner,sun8i-h3";
  
  fragment@0 {
    target-path = "/";

    __overlay__ {
      leds {
        compatible = "gpio-leds";

        status_led {
          label = "orangepi:red:sys";
          default-state = "off";
        };

        pwr_led {
          label = "orangepi:green:net";
          default-state = "off";
        };
      };
    };
  };
};
