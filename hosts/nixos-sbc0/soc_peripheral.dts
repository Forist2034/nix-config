/dts-v1/;
/plugin/;
/ {
  compatible = "xunlong,orangepi-lite", "allwinner,sun8i-h3";
};
&usb_otg {
  status = "okay";
};
&codec {
  allwinner,audio-routing =
		  "Line Out", "LINEOUT",
			"MIC1", "Mic",
			"Mic",  "MBIAS";
  status = "okay";
};
&csi {
  status = "okay";
};
